## CMakeLists.txt
```
cmake_minimum_required(VERSION 3.20.0)

find_package(Zephyr REQUIRED HINTS $ENV{ZEPHYR_BASE})
project(sys_ctrl_test)

target_sources(app PRIVATE src/main.c)

# We want to test sys_ctrl in isolation
add_subdirectory(${CMAKE_CURRENT_SOURCE_DIR}/../../app/src/common common)
add_subdirectory(${CMAKE_CURRENT_SOURCE_DIR}/../../app/src/modules/sys_ctrl sys_ctrl)

target_include_directories(app PRIVATE ${CMAKE_CURRENT_SOURCE_DIR}/../../app/include)
target_include_directories(app PRIVATE ${CMAKE_CURRENT_SOURCE_DIR}/../../app/src)
```

## sample.yaml
```
sample:
  description: System Controller unit tests
  name: sys_ctrl_test
tests:
  sample.sys_ctrl:
    integration_platforms:
      - native_sim
    tags: test
```

## prj.conf
```kconfig
CONFIG_ZTEST=y
CONFIG_ZBUS=y
CONFIG_SHELL=n

CONFIG_LOG=y
```

## src/main.c
```c
#include <zephyr/ztest.h>
#include <zephyr/zbus/zbus.h>
#include <zephyr/logging/log.h>
#include "message_channel.h"
#include "modules/sys_ctrl/sys_ctrl.h"

LOG_MODULE_REGISTER(test);

ZTEST_SUITE(sys_ctrl_suite, NULL, NULL, NULL, NULL, NULL);

ZTEST(sys_ctrl_suite, test_initial_state)
{
	zassert_equal(sys_ctrl_get_state(), SYS_STANDBY, "Initial state should be SYS_STANDBY");
}

ZTEST(sys_ctrl_suite, test_state_transitions)
{
	/* Initial should be STANDBY */
	zassert_equal(sys_ctrl_get_state(), SYS_STANDBY, "Expected STANDBY");

	/* Press button -> Should go to SLEEP */
	sys_ctrl_handle_button_press();
	zassert_equal(sys_ctrl_get_state(), SYS_SLEEP, "Expected transition to SLEEP");

	/* Press button again -> Should go back to STANDBY */
	sys_ctrl_handle_button_press();
	zassert_equal(sys_ctrl_get_state(), SYS_STANDBY, "Expected transition back to STANDBY");
}
```
