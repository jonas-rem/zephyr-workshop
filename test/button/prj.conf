## CMakeLists.txt
```
cmake_minimum_required(VERSION 3.20.0)

find_package(Zephyr REQUIRED HINTS $ENV{ZEPHYR_BASE})
project(button_sample)

target_sources(app PRIVATE src/main.c)
add_subdirectory(../../app/src/common common)
add_subdirectory(../../app/src/modules/button button)
```

## Kconfig
```
menu "Button Test"

rsource "../../app/src/modules/button/Kconfig.button"

endmenu

menu "Zephyr Kernel"
source "Kconfig.zephyr"
endmenu
```

## sample.yaml
```
sample:
  description: Button module sample
  name: button_module_sample
common:
  tags: introduction
  integration_platforms:
    - native_sim
    - reel_board
    - frdm_k64f
    - nucleo_wb55rg
    - nucleo_l496zg
    - mimxrt1010_evk
    - nucleo_l452re
    - nrf5340dk/nrf5340/cpuapp
    - stm32f4_disco
    # The following platforms are not supported in twister currently
    #- nrf52833dk_nrf52833
    #- atsamr21_xpro
tests:
  sample.basic.button:
    tags: introduction
    harness: console
    harness_config:
      type: one_line
      regex:
        - "Button test start"
```

## prj.conf
```kconfig
# Logging
CONFIG_LOG=y
# Make Logging more responsive for better visualization
CONFIG_LOG_PROCESS_TRIGGER_THRESHOLD=1
CONFIG_BUTTON_MODULE_LOG_LEVEL_DBG=y

# ZBus
CONFIG_ZBUS=y

# GPIO for Button control
CONFIG_GPIO=y
```

## boards/native_sim.overlay
```dts
/**
 * Native Sim Overlay for Button Test
 *
 * This overlay adds a button (sw0) alias for the native_sim board
 * to enable the button module to compile and run.
 */

/ {
	aliases {
		sw0 = &button0;
	};

	buttons {
		compatible = "gpio-keys";
		button0: button_0 {
			gpios = <&gpio0 1 GPIO_ACTIVE_LOW>;
			label = "User button";
		};
	};
};
```

## src/main.c
```c
#include <zephyr/kernel.h>
#include <zephyr/zbus/zbus.h>

#include "message_channel.h"

#include <zephyr/logging/log.h>
LOG_MODULE_REGISTER(app, CONFIG_BUTTON_MODULE_LOG_LEVEL);


void button_test_msg_cb(const struct zbus_channel *chan)
{
	const enum sys_events *msg_type;

	/* Get message from channel. */
	msg_type = zbus_chan_const_msg(chan);

	switch (*msg_type) {
	case SYS_BUTTON_PRESSED:
		LOG_INF("Button pressed!");
		break;
	default:
		/* Ignore nonrelevant messages */
		break;
	}
}

int main(void)
{
	LOG_INF("Button test start");

	return 0;
}

ZBUS_LISTENER_DEFINE(button_test, button_test_msg_cb);
ZBUS_CHAN_ADD_OBS(button_ch, button_test, DEFAULT_OBS_PRIO);
```
