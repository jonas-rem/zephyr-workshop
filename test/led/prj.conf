## CMakeLists.txt
```
cmake_minimum_required(VERSION 3.20.0)

find_package(Zephyr REQUIRED HINTS $ENV{ZEPHYR_BASE})
project(led_sample)

target_sources(app PRIVATE src/main.c)
add_subdirectory(./../../app/src/common common)
add_subdirectory(./../../app/src/modules/led led)
```

## Kconfig
```
menu "LED Test"

rsource "../../app/src/modules/led/Kconfig.led"

endmenu

menu "Zephyr Kernel"
source "Kconfig.zephyr"
endmenu
```

## sample.yaml
```
sample:
  description: LED module sample
  name: led_module_sample
common:
  tags: introduction
  integration_platforms:
    - native_sim
    - reel_board
    - frdm_k64f
    - nucleo_wb55rg
    - nucleo_l496zg
    - mimxrt1010_evk
    - nucleo_l452re
    - nrf5340dk/nrf5340/cpuapp
    - stm32f4_disco
    # The following platforms are not supported in twister currently
    #- nrf52833dk_nrf52833
    #- atsamr21_xpro
tests:
  sample.basic.led:
    tags: introduction
    harness: console
    harness_config:
      type: one_line
      regex:
        - "LED module started"
```

## prj.conf
```kconfig
# Logging
CONFIG_LOG=y
# Make Logging more responsive for better visualization
CONFIG_LOG_PROCESS_TRIGGER_THRESHOLD=1
CONFIG_LED_MODULE_LOG_LEVEL_DBG=y

# ZBus
CONFIG_ZBUS=y

# Shell Testing
CONFIG_SHELL=y

# GPIO for LED control
CONFIG_GPIO=y
```

## src/main.c
```c
#include <zephyr/zbus/zbus.h>
#include <zephyr/shell/shell.h>

#include "message_channel.h"

#include <zephyr/logging/log.h>
LOG_MODULE_REGISTER(app, CONFIG_LED_MODULE_LOG_LEVEL);

static void led_msg(enum sys_states msg)
{
	int err;

	err = zbus_chan_pub(&led_ch, &msg, K_SECONDS(1));
	if (err) {
		LOG_ERR("zbus_chan_pub, error: %d", err);
	}
}

static int cmd_led(const struct shell *sh, size_t argc, char **argv,
		    void *data)
{
	int val = (intptr_t)data;

	switch (val) {
	case 0:
		led_msg(SYS_SLEEP);
		break;
	case 1:
		led_msg(SYS_STANDBY);
		break;
	/* Add your code here */

	/* */
	default:
		shell_print(sh, "Invalid argument");
		break;
	}

	return 0;
}

SHELL_SUBCMD_DICT_SET_CREATE(sub_led_cmds, cmd_led,
	(sys_sleep, 0, "System is sleeping"),
	(sys_standby, 1, "System is in standby")
	/* Add your code here */

	/* */
);

SHELL_STATIC_SUBCMD_SET_CREATE(my_app_cmds,
	SHELL_CMD(led, &sub_led_cmds, "Led module commands", NULL),
	SHELL_SUBCMD_SET_END /* Array terminated. */
);
SHELL_CMD_REGISTER(my_app, &my_app_cmds, "my App test", NULL);

int main(void)
{
	return 0;
}
```
