## samples/sim_test_track/src/modules/sensor/tests/Kconfig
```kconfig
menu "Application"
rsource "../Kconfig.sensor"
endmenu

menu "Zephyr Kernel"
source "Kconfig.zephyr"
endmenu
```

## samples/simulation/src/modules/button/Kconfig.button
```kconfig
config APP_SIM_BUTTON
	bool "Button module"
	default y
	depends on GPIO && ZBUS

if APP_SIM_BUTTON

module = APP_SIM_BUTTON
module-str = BUTTON
source "subsys/logging/Kconfig.template.log_config"

config APP_SIM_BUTTON_INIT_PRIORITY
	int "Button initialization priority"
	default 80

config APP_SIM_BUTTON_SHELL
	bool "Button emulator shell command"
	default y
	depends on SHELL && GPIO_EMUL

endif
```

## samples/simulation/src/modules/button/tests/Kconfig
```kconfig
menu "Application"
rsource "../Kconfig.button"
endmenu

menu "Zephyr Kernel"
source "Kconfig.zephyr"
endmenu
```

## samples/simulation/src/modules/led/Kconfig.led
```kconfig
config APP_SIM_LED
	bool "LED module"
	default y
	depends on GPIO && ZBUS && ZBUS_MSG_SUBSCRIBER

if APP_SIM_LED

module = APP_SIM_LED
module-str = LED
source "subsys/logging/Kconfig.template.log_config"

config APP_SIM_LED_THREAD_PRIORITY
	int "LED thread priority"
	default 5

endif
```

## samples/simulation/src/modules/sensor/Kconfig.sensor
```kconfig
config APP_SIM_SENSOR
	bool "Temperature and humidity sensor module"
	default y
	depends on SENSOR && ZBUS && ZBUS_MSG_SUBSCRIBER

if APP_SIM_SENSOR

module = APP_SIM_SENSOR
module-str = SENSOR
source "subsys/logging/Kconfig.template.log_config"

config APP_SIM_SENSOR_THREAD_PRIORITY
	int "Sensor thread priority"
	default 5

config APP_SIM_SENSOR_SHELL
	bool "Sensor shell commands"
	default y
	depends on SHELL

endif
```
