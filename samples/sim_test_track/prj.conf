## CMakeLists.txt
```
cmake_minimum_required(VERSION 3.20.0)

include(${CMAKE_CURRENT_SOURCE_DIR}/../../cmake/workshop_board.cmake)
find_package(Zephyr REQUIRED HINTS $ENV{ZEPHYR_BASE})
project(sim_test_track)

zephyr_include_directories(src/common)

target_sources(app PRIVATE src/main.c)
add_subdirectory(src/common common)

if(CONFIG_SIM_TEST_TRACK_BUTTON)
  add_subdirectory(src/modules/button button)
endif()

if(CONFIG_SIM_TEST_TRACK_SENSOR)
  add_subdirectory(src/modules/sensor sensor)
endif()

if(CONFIG_SIM_TEST_TRACK_LED)
  add_subdirectory(src/modules/led led)
endif()
```

## Kconfig
```
menu "Sim and testing track"

rsource "src/modules/button/Kconfig.button"
rsource "src/modules/sensor/Kconfig.sensor"
rsource "src/modules/led/Kconfig.led"

endmenu

menu "Zephyr Kernel"
source "Kconfig.zephyr"
endmenu
```

## prj.conf
```kconfig
CONFIG_LOG=y
# Flush the deferred log promptly so traces follow the event that caused them.
CONFIG_LOG_PROCESS_THREAD_SLEEP_MS=10
CONFIG_SIM_TEST_TRACK_BUTTON_LOG_LEVEL_DBG=y
CONFIG_SIM_TEST_TRACK_SENSOR_LOG_LEVEL_DBG=y
CONFIG_SIM_TEST_TRACK_LED_LOG_LEVEL_DBG=y

CONFIG_SIM_TEST_TRACK_BUTTON=y
CONFIG_SIM_TEST_TRACK_SENSOR=y
CONFIG_SIM_TEST_TRACK_LED=y

CONFIG_GPIO=y
CONFIG_I2C=y
CONFIG_SENSOR=y
CONFIG_ZBUS=y
CONFIG_ZBUS_MSG_SUBSCRIBER=y
CONFIG_ZBUS_MSG_SUBSCRIBER_BUF_ALLOC_STATIC=y
CONFIG_ZBUS_MSG_SUBSCRIBER_NET_BUF_STATIC_DATA_SIZE=32
CONFIG_ZBUS_MSG_SUBSCRIBER_NET_BUF_POOL_SIZE=16

CONFIG_SHELL=y
```

## src/main.c
```c
/*
 * Copyright (c) 2026 Jonas Remmert
 * SPDX-License-Identifier: Apache-2.0
 */

#include <zephyr/logging/log.h>

LOG_MODULE_REGISTER(sim_test_track, LOG_LEVEL_INF);

int main(void)
{
	LOG_INF("Sim and testing track booted");
	return 0;
}
```
