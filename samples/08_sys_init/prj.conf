## CMakeLists.txt
```
# SPDX-License-Identifier: Apache-2.0

cmake_minimum_required(VERSION 3.20.0)

find_package(Zephyr REQUIRED HINTS $ENV{ZEPHYR_BASE})
project(hello_world)

target_sources(app PRIVATE
    src/main.c
    src/module_1.c
    src/module_2.c
)
```

## sample.yaml
```
sample:
  description: Demonstrates SYS_INIT macro for automatic
    module initialization
  name: sys_init
common:
  tags:
    - sys_init
    - initialization
  integration_platforms:
    - native_sim
    - reel_board
  harness: console
  harness_config:
    type: multi_line
    ordered: true
    regex:
      - "Module 1 initialized.*APPLICATION.*priority: 0"
      - "Module 2 initialized.*APPLICATION.*priority: 999"
      - "Hello World!.*"
tests:
  sample.basic.sys_init:
    tags:
      - sys_init
      - initialization
```

## prj.conf
```kconfig
# Enable logging subsystem
```

## src/module_1.c
```c
#include <zephyr/kernel.h>

#define MODULE_1_INIT_PRIORITY 0

int module_1_init(void)
{
	printk("Module 1 initialized (priority: APPLICATION, level: %d)\n",
		MODULE_1_INIT_PRIORITY);

	return 0;
}

/* Register module_1_init to run at APPLICATION level with priority 0 */
SYS_INIT(module_1_init, APPLICATION, MODULE_1_INIT_PRIORITY);
```

## src/module_2.c
```c
#include <zephyr/kernel.h>
#include <zephyr/sys/printk.h>

/*
 * This module demonstrates SYS_INIT with APPLICATION level priority.
 * Higher priority value (10) means it runs after lower priority values.
 */

#define MODULE_2_INIT_PRIORITY 999

int module_2_init(void)
{
	printk("Module 2 initialized (priority: APPLICATION, level: %d)\n",
	       MODULE_2_INIT_PRIORITY);

	return 0;
}

/* Register module_2_init to run at APPLICATION level with priority 10 */
/* Higher priority number = runs later within the same level */
SYS_INIT(module_2_init, APPLICATION, MODULE_2_INIT_PRIORITY);
```
