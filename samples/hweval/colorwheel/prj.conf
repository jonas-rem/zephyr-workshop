## CMakeLists.txt
```
# SPDX-FileCopyrightText: Copyright (c) 2026 Navimatix GmbH
# SPDX-FileCopyrightText: Copyright (c) 2026 TiaC Systems
# SPDX-License-Identifier: Apache-2.0

cmake_minimum_required(VERSION 3.20.0)

# Standard Zephyr application boilerplate.
find_package(Zephyr REQUIRED HINTS $ENV{ZEPHYR_BASE})
project("RGB Matrix Colour Wheel" VERSION 0.1)

assert(CONFIG_DISPLAY "Zephyr's display driver API must be enabled")

target_sources(app PRIVATE
    src/main.c
    src/hsv.c
    src/polar.c
)

target_include_directories(app PRIVATE
    src
)
```

## Kconfig
```
# SPDX-FileCopyrightText: Copyright (c) 2026 Navimatix GmbH
# SPDX-FileCopyrightText: Copyright (c) 2026 TiaC Systems
# SPDX-License-Identifier: Apache-2.0

menu "RGB matrix color wheel sample settings"

config COLORWHEEL_HUE_STEP
	int "Hue rotation per frame [degrees]"
	range 0 360
	default 1
	help
	  How far the color wheel rotates around the centre of the
	  panel between two consecutive frames. Set to 0 to render a
	  static wheel.

config COLORWHEEL_FRAME_INTERVAL
	int "Delay between two frames [milliseconds]"
	range 1 10000
	default 20
	help
	  Time to sleep between two consecutive frames. Together with
	  COLORWHEEL_HUE_STEP this defines the angular speed of the wheel.
	  The default of 40 ms gives 25 frames per second.

config COLORWHEEL_SAT_SCALE
	int "Radius of full saturation [% of corner distance]"
	range 1 100
	default 50
	help
	  Radius at which the saturation ramp reaches full saturation,
	  as a percentage of the distance from the centre to a corner.
	  Beyond this radius the color stays fully saturated all the
	  way into the corners.

config COLORWHEEL_MAX_BRIGHTNESS
	int "Brightness ceiling"
	range 1 255
	default 8
	help
	  The brightness every pixel is driven at. The radial ramp is
	  carried by saturation alone, so this option sets the brightness
	  of the whole panel directly.

module = COLORWHEEL
module-str = "colorwheel"
source "subsys/logging/Kconfig.template.log_config"

endmenu

# Sources Kconfig.zephyr in the Zephyr root directory.
menu "Zephyr Kernel"
source "Kconfig.zephyr"
endmenu
```

## prj.conf
```kconfig
# SPDX-FileCopyrightText: Copyright (c) 2026 Navimatix GmbH
# SPDX-FileCopyrightText: Copyright (c) 2026 TiaC Systems
# SPDX-License-Identifier: Apache-2.0

# display API on top of an LED strip matrix
CONFIG_DISPLAY=y
CONFIG_LED_STRIP=y

# console output and logging
CONFIG_BOOT_BANNER=y
CONFIG_LOG=y
CONFIG_PRINTK=y
```

## src/main.c
```c
/*
 * SPDX-FileCopyrightText: Copyright (c) 2026 Navimatix GmbH
 * SPDX-FileCopyrightText: Copyright (c) 2026 TiaC Systems
 * SPDX-License-Identifier: Apache-2.0
 */

#include <string.h>

#include <zephyr/kernel.h>
#include <zephyr/device.h>
#include <zephyr/devicetree.h>
#include <zephyr/drivers/display.h>
#include <zephyr/logging/log.h>

#include "hsv.h"
#include "polar.h"

LOG_MODULE_REGISTER(colorwheel, CONFIG_COLORWHEEL_LOG_LEVEL);

#if !DT_HAS_CHOSEN(zephyr_display)
#error "This sample needs an RGB matrix assigned to the chosen zephyr,display node"
#endif

#define MATRIX_NODE   DT_CHOSEN(zephyr_display)
#define MATRIX_WIDTH  DT_PROP(MATRIX_NODE, width)
#define MATRIX_HEIGHT DT_PROP(MATRIX_NODE, height)

/* The frame buffer is sized at build time for the worst case, ARGB_8888
 * with four bytes per pixel. The actual pixel format is queried at run
 * time and may be narrower.
 */
#define MATRIX_MAX_BPP 4U
#define FRAME_BUF_SIZE ((size_t)MATRIX_WIDTH * MATRIX_HEIGHT * MATRIX_MAX_BPP)

static uint8_t frame_buf[FRAME_BUF_SIZE];

/** @brief Bytes per pixel, or 0 if the format is not supported. */
static size_t bytes_per_pixel(enum display_pixel_format format)
{
	switch (format) {
	case PIXEL_FORMAT_ARGB_8888:
		return 4U;
	case PIXEL_FORMAT_RGB_888:
		return 3U;
	default:
		return 0U;
	}
}

/** @brief Write one color to the frame buffer at @p dst. */
static void put_pixel(uint8_t *dst, enum display_pixel_format format, const struct hsv_rgb *color)
{
	if (format == PIXEL_FORMAT_ARGB_8888) {
		uint32_t argb = 0xFF000000U | ((uint32_t)color->r << 16) |
				((uint32_t)color->g << 8) | (uint32_t)color->b;

		/* An unaligned native store, matching how the LED strip
		 * matrix driver reads the pixel back.
		 */
		memcpy(dst, &argb, sizeof(argb));
	} else {
		dst[0] = color->r;
		dst[1] = color->g;
		dst[2] = color->b;
	}
}

/**
 * @brief Paint one full frame of the color wheel into @p buf.
 *
 * Each pixel is placed in polar coordinates centred on the panel. Hue
 * follows the polar angle, so a full rainbow wraps once around the
 * centre, while saturation rises with the radius: a bright white core
 * in the centre blooms into fully saturated color. The radius is
 * normalised against a fraction of the corner distance set by
 * CONFIG_COLORWHEEL_SAT_SCALE, so the ramp reaches full saturation
 * before the corners. The value is fixed at
 * CONFIG_COLORWHEEL_MAX_BRIGHTNESS, keeping the white core bright and
 * bounding the panel's current draw.
 *
 * Advancing @p phase between frames rotates the wheel.
 */
static void render_frame(uint8_t *buf, uint16_t width, uint16_t height,
			 enum display_pixel_format format, size_t bpp, uint16_t phase)
{
	/* Pixel-centred coordinates in units of 1/8 pixel, so the origin lands on the geometric
	 * centre of the panel even when a dimension is even and no pixel sits exactly on it.
	 */
	const uint32_t center_w = (uint32_t)width * COLORWHEEL_COORD_ONE - 1U;
	const uint32_t center_h = (uint32_t)height * COLORWHEEL_COORD_ONE - 1U;

	/* Reference radius: the panel corner, in the same units. The saturation ramp is scaled to
	 * reach full saturation at a fraction of this corner distance. The scale is a percentage,
	 * so the computation stays in integer arithmetic.
	 */
	const int32_t corner_x = (int32_t)(center_w / 2U);
	const int32_t corner_y = (int32_t)(center_h / 2U);
	const uint32_t corner = polar_isqrt((uint32_t)(corner_x * corner_x + corner_y * corner_y));
	const uint32_t radius_max = (corner * (uint32_t)CONFIG_COLORWHEEL_SAT_SCALE) / 100U;

	for (uint16_t y = 0U; y < height; y++) {
		for (uint16_t x = 0U; x < width; x++) {
			const int32_t fx = (int32_t)((uint32_t)x * COLORWHEEL_COORD_ONE) -
					   (int32_t)(center_w / 2U);
			const int32_t fy = (int32_t)((uint32_t)y * COLORWHEEL_COORD_ONE) -
					   (int32_t)(center_h / 2U);
			const uint32_t radius = polar_isqrt((uint32_t)(fx * fx + fy * fy));
			const uint16_t angle = polar_atan2_deg(fy, fx);
			struct hsv_rgb color;
			uint32_t saturation;

			/* Saturation is the radius normalised to [0, 255] against the scaled
			 * reference: a white core in the centre, fully saturated color at the
			 * reference radius, clamped beyond it. The value stays at the brightness
			 * ceiling, so the core stays bright and the panel draws a bounded current.
			 */
			saturation = (radius_max != 0U) ? ((radius * 255U) / radius_max) : 0U;
			if (saturation > 255U) {
				saturation = 255U;
			}

			hsv_to_rgb((uint16_t)(((uint32_t)angle + phase) % 360U),
				   (uint8_t)saturation, (uint8_t)CONFIG_COLORWHEEL_MAX_BRIGHTNESS,
				   &color);

			put_pixel(buf, format, &color);
			buf += bpp;
		}
	}
}

int main(void)
{
	const struct device *const display = DEVICE_DT_GET(MATRIX_NODE);
	struct display_buffer_descriptor desc;
	struct display_capabilities caps;
	enum display_pixel_format format;
	uint16_t phase = 0U;
	size_t bpp;
	int ret;

	if (!device_is_ready(display)) {
		LOG_ERR("Display device %s is not ready", display->name);
		return -ENODEV;
	}

	display_get_capabilities(display, &caps);
	format = caps.current_pixel_format;
	bpp = bytes_per_pixel(format);

	if (bpp == 0U) {
		LOG_ERR("Pixel format %d is not supported, need RGB_888 or ARGB_8888", format);
		return -ENOTSUP;
	}

	if ((caps.x_resolution > MATRIX_WIDTH) || (caps.y_resolution > MATRIX_HEIGHT)) {
		LOG_ERR("Display is %ux%u, but the frame buffer only holds %ux%u",
			caps.x_resolution, caps.y_resolution, (unsigned int)MATRIX_WIDTH,
			(unsigned int)MATRIX_HEIGHT);
		return -ENOMEM;
	}

	/* The LED strip matrix driver does not implement blanking,
	 * so -ENOSYS is not an error.
	 */
	ret = display_blanking_off(display);
	if ((ret < 0) && (ret != -ENOSYS)) {
		LOG_ERR("Failed to switch off display blanking (%d)", ret);
		return ret;
	}

	desc.width = caps.x_resolution;
	desc.height = caps.y_resolution;
	desc.pitch = caps.x_resolution;
	desc.buf_size = (uint32_t)caps.x_resolution * caps.y_resolution * bpp;
	desc.frame_incomplete = false;

	LOG_INF("Color wheel on a %ux%u RGB matrix, %u bytes per pixel, %u ms per frame",
		caps.x_resolution, caps.y_resolution, (unsigned int)bpp,
		(unsigned int)CONFIG_COLORWHEEL_FRAME_INTERVAL);

	while (true) {
		render_frame(frame_buf, caps.x_resolution, caps.y_resolution, format, bpp, phase);

		ret = display_write(display, 0, 0, &desc, frame_buf);
		if (ret < 0) {
			LOG_ERR("Failed to write a frame to the display (%d)", ret);
			return ret;
		}

		phase = (uint16_t)((phase + CONFIG_COLORWHEEL_HUE_STEP) % 360U);

		k_sleep(K_MSEC(CONFIG_COLORWHEEL_FRAME_INTERVAL));
	}
}
```

## src/hsv.c
```c
/*
 * SPDX-FileCopyrightText: Copyright (c) 2026 Navimatix GmbH
 * SPDX-FileCopyrightText: Copyright (c) 2026 TiaC Systems
 * SPDX-License-Identifier: Apache-2.0
 */

#include "hsv.h"

/** Scale @p a by the fraction @p b / 255, rounding towards zero. */
#define SCALE8(a, b) ((uint8_t)(((uint32_t)(a) * (uint32_t)(b)) / 255U))

void hsv_to_rgb(uint16_t hue, uint8_t sat, uint8_t val, struct hsv_rgb *out)
{
	uint8_t sector;
	uint8_t offset;
	uint8_t p, q, t;

	if (sat == 0U) {
		/* No saturation means a pure shade of grey. */
		out->r = val;
		out->g = val;
		out->b = val;
		return;
	}

	hue %= 360U;

	/* The six 60 degree sectors of the color wheel, plus the offset within
	 * the sector rescaled from [0, 60) to [0, 255].
	 */
	sector = (uint8_t)(hue / 60U);
	offset = (uint8_t)(((hue % 60U) * 255U) / 60U);

	/* The three secondary levels of the classic HSV conversion:
	 * p is the falling channel, q falls and t rises within the sector.
	 */
	p = SCALE8(val, 255U - sat);
	q = SCALE8(val, 255U - SCALE8(sat, offset));
	t = SCALE8(val, 255U - SCALE8(sat, 255U - offset));

	switch (sector) {
	case 0: /* red -> yellow */
		out->r = val;
		out->g = t;
		out->b = p;
		break;
	case 1: /* yellow -> green */
		out->r = q;
		out->g = val;
		out->b = p;
		break;
	case 2: /* green -> cyan */
		out->r = p;
		out->g = val;
		out->b = t;
		break;
	case 3: /* cyan -> blue */
		out->r = p;
		out->g = q;
		out->b = val;
		break;
	case 4: /* blue -> magenta */
		out->r = t;
		out->g = p;
		out->b = val;
		break;
	default: /* magenta -> red */
		out->r = val;
		out->g = p;
		out->b = q;
		break;
	}
}
```

## src/hsv.h
```c
/*
 * SPDX-FileCopyrightText: Copyright (c) 2026 Navimatix GmbH
 * SPDX-FileCopyrightText: Copyright (c) 2026 TiaC Systems
 * SPDX-License-Identifier: Apache-2.0
 */

#ifndef COLORWHEEL_HSV_H_
#define COLORWHEEL_HSV_H_

#include <stdint.h>

#ifdef __cplusplus
extern "C" {
#endif

/** @brief A color in the sRGB cube, one byte per channel. */
struct hsv_rgb {
	uint8_t r;
	uint8_t g;
	uint8_t b;
};

/**
 * @brief Convert an HSV color into its RGB representation.
 *
 * The conversion is done entirely in integer arithmetic, so it is cheap
 * enough to run per pixel and per frame even on a core without an FPU.
 *
 * @param hue Hue in degrees. Values outside [0, 360) are wrapped.
 * @param sat Saturation, from 0 (grey) to 255 (fully saturated).
 * @param val Value (brightness), from 0 (black) to 255 (full).
 * @param out Destination color, must not be @c NULL.
 */
void hsv_to_rgb(uint16_t hue, uint8_t sat, uint8_t val, struct hsv_rgb *out);

#ifdef __cplusplus
}
#endif

#endif /* COLORWHEEL_HSV_H_ */
```

## src/polar.c
```c
/*
 * SPDX-FileCopyrightText: Copyright (c) 2026 Navimatix GmbH
 * SPDX-FileCopyrightText: Copyright (c) 2026 TiaC Systems
 * SPDX-License-Identifier: Apache-2.0
 */

#include "polar.h"

/*
 * First octant arctangent, shared by both branches of polar_atan2_deg.
 *
 * Approximates atan(r) for a ratio @p r already scaled into [0, 1024] and
 * returns the angle in 1/1024 of a degree, using the rational form
 *
 *   atan(r) ~= r * (45 + 15.65 * (1 - r))        (degrees, 0 <= r <= 1)
 *
 * with a worst case error of 0.21 degrees. The coefficient is carried as
 * 15.65 * 1024 = 16026 to keep the evaluation in 32 bit integer
 * arithmetic, cheap enough for a per pixel inner loop without an FPU. The
 * error is far below the angular resolution of a discrete matrix, where
 * one pixel step near the centre spans several degrees.
 */
#define ATAN_K0 (45 * 1024)
#define ATAN_K1 16026

static int32_t atan_first_octant(int32_t r)
{
	return (r * (ATAN_K0 + ATAN_K1 - ((ATAN_K1 * r) >> 10))) >> 10;
}

uint16_t polar_atan2_deg(int32_t y, int32_t x)
{
	const int32_t ax = (x >= 0) ? x : -x;
	const int32_t ay = (y >= 0) ? y : -y;
	int32_t angle;

	if ((ax == 0) && (ay == 0)) {
		return 0U;
	}

	/* Fold the vector into the first octant, evaluate the arctangent of
	 * the slope, then re-apply the signs to unfold the reflections
	 * into the correct quadrant.
	 */
	if (ax >= ay) {
		angle = atan_first_octant((ay << 10) / ax) >> 10;
	} else {
		angle = 90 - (atan_first_octant((ax << 10) / ay) >> 10);
	}

	if (y < 0) {
		angle = -angle;
	}
	if (x < 0) {
		angle = 180 - angle;
	}

	return (uint16_t)(((angle % 360) + 360) % 360);
}

uint32_t polar_isqrt(uint32_t v)
{
	uint32_t r = 0U;
	uint32_t bit = 1UL << 30;

	while (bit > v) {
		bit >>= 2;
	}

	while (bit != 0U) {
		if (v >= r + bit) {
			v -= r + bit;
			r = (r >> 1) + bit;
		} else {
			r >>= 1;
		}
		bit >>= 2;
	}

	return r;
}
```

## src/polar.h
```c
/*
 * SPDX-FileCopyrightText: Copyright (c) 2026 Navimatix GmbH
 * SPDX-FileCopyrightText: Copyright (c) 2026 TiaC Systems
 * SPDX-License-Identifier: Apache-2.0
 */

#ifndef COLORWHEEL_POLAR_H_
#define COLORWHEEL_POLAR_H_

#include <stdint.h>

#ifdef __cplusplus
extern "C" {
#endif

/** Fixed point shift for pixel-centred coordinates, units of 1/8 pixel. */
#define COLORWHEEL_COORD_SHIFT 3U
/** One pixel step in the fixed point coordinates. */
#define COLORWHEEL_COORD_ONE   (1U << COLORWHEEL_COORD_SHIFT)

/**
 * @brief Four quadrant arctangent in degrees.
 *
 * Computes the angle of the vector (@p y, @p x) counter-clockwise from the
 * positive x axis, mapped into [0, 360). Integer only, cheap enough to
 * evaluate per pixel and per frame on a core without an FPU, and accurate
 * to within a single step of the color wheel.
 *
 * @param y Y coordinate of the vector, in any fixed point unit.
 * @param x X coordinate of the vector, in the same unit as @p y.
 * @return Angle in degrees, from 0 up to but not including 360.
 */
uint16_t polar_atan2_deg(int32_t y, int32_t x);

/**
 * @brief Integer square root via the bit by bit method.
 *
 * @param v Input value.
 * @return The largest integer @p r with @p r * @p r <= @p v.
 */
uint32_t polar_isqrt(uint32_t v);

#ifdef __cplusplus
}
#endif

#endif /* COLORWHEEL_POLAR_H_ */
```
