## CMakeLists.txt
```
# SPDX-FileCopyrightText: Copyright (c) 2026 Navimatix GmbH
# SPDX-FileCopyrightText: Copyright (c) 2021-2026 TiaC Systems
# SPDX-FileCopyrightText: Copyright (c) 2019-2021 Li-Pro.Net
# SPDX-License-Identifier: Apache-2.0

cmake_minimum_required(VERSION 3.20.0)

# Standard Zephyr application boilerplate.
find_package(Zephyr REQUIRED HINTS $ENV{ZEPHYR_BASE})
project("My Shell" VERSION 0.1)

assert(CONFIG_SHELL "Zephyr's embedded shell must be enabled")

# Add your source file to the "app" target. This must come after
# the boilerplate code, which defines the target.
target_sources(app PRIVATE src/main.c)
```

## prj.conf
```kconfig
# SPDX-FileCopyrightText: Copyright (c) 2026 Navimatix GmbH
# SPDX-FileCopyrightText: Copyright (c) 2021-2026 TiaC Systems
# SPDX-FileCopyrightText: Copyright (c) 2019-2021 Li-Pro.Net
# SPDX-License-Identifier: Apache-2.0

# Multi-threaded, with thread monitoring and timer support in the kernel
CONFIG_ERRNO=y

CONFIG_MULTITHREADING=y
CONFIG_NUM_COOP_PRIORITIES=16
CONFIG_NUM_METAIRQ_PRIORITIES=0

CONFIG_SCHED_SIMPLE=y
CONFIG_WAITQ_SIMPLE=y

CONFIG_INIT_STACKS=y

CONFIG_POSIX_API=y
CONFIG_POSIX_TIMERS=y

# Thread monitoring and statistics in the kernel
CONFIG_THREAD_MONITOR=y
CONFIG_THREAD_NAME=y
CONFIG_THREAD_STACK_INFO=y
CONFIG_THREAD_RUNTIME_STATS=y
CONFIG_THREAD_RUNTIME_STATS_USE_TIMING_FUNCTIONS=y

# Shell with log, getopt, stats and full command set
CONFIG_BOOT_BANNER=y
CONFIG_DATE_SHELL=y
CONFIG_DEVICE_SHELL=y
CONFIG_DEVMEM_SHELL=y
CONFIG_KERNEL_SHELL=y
CONFIG_LOG=y
CONFIG_LOG_CMDS=y
CONFIG_STATS=y
CONFIG_STATS_SHELL=y
CONFIG_PRINTK=y
CONFIG_SHELL=y
CONFIG_SHELL_GETOPT=y
CONFIG_SHELL_HELP=y

# Shell with hwinfo, regulator, and counter commands
CONFIG_COUNTER=y
CONFIG_COUNTER_SHELL=y
CONFIG_HWINFO=y
CONFIG_HWINFO_SHELL=y
CONFIG_REGULATOR=y
CONFIG_REGULATOR_SHELL=y

# Shell with eeprom, flash, led, rtc, and sensor commands
CONFIG_EEPROM=y
CONFIG_EEPROM_SHELL=y
CONFIG_FLASH=y
CONFIG_FLASH_SHELL=y
CONFIG_LED=y
CONFIG_LED_SHELL=y
CONFIG_RTC=y
CONFIG_RTC_SHELL=y
CONFIG_SENSOR=y
CONFIG_SENSOR_INFO=y
CONFIG_SENSOR_SHELL=y

# Shell with adc, dac, pwm, gpio, and i2c commands
CONFIG_ADC=y
CONFIG_ADC_SHELL=y
CONFIG_DAC=y
CONFIG_DAC_SHELL=y
CONFIG_GPIO=y
CONFIG_GPIO_SHELL=y
CONFIG_I2C=y
CONFIG_I2C_SHELL=y
CONFIG_PWM=y
CONFIG_PWM_SHELL=y
```

## boards/waveshare_rp2350_matrix_rp2350a_hazard3.conf
```kconfig
# SPDX-FileCopyrightText: Copyright (c) 2026 Navimatix GmbH
# SPDX-FileCopyrightText: Copyright (c) 2026 TiaC Systems
# SPDX-License-Identifier: Apache-2.0

# enable specific components
CONFIG_LED_STRIP=y
CONFIG_LED_STRIP_SHELL=y
CONFIG_LED_STRIP_SHELL_MAX_PIXELS=64
```

## src/main.c
```c
/*
 * SPDX-FileCopyrightText: Copyright (c) 2026 Navimatix GmbH
 * SPDX-FileCopyrightText: Copyright (c) 2021-2026 TiaC Systems
 * SPDX-FileCopyrightText: Copyright (c) 2019-2021 Li-Pro.Net
 * SPDX-FileCopyrightText: Copyright (c) 2012-2014 Wind River Systems, Inc.
 * SPDX-License-Identifier: Apache-2.0
 */

#include <zephyr/kernel.h>
#include <zephyr/init.h>
#include <zephyr/sys/printk.h>

static int say_hello(void)
{
	printk("Hardware Evaluation! I'm THE My Shell from %s\n", CONFIG_BOARD);
	return 0;
}

/* Register our hello function  */
SYS_INIT(say_hello, APPLICATION, CONFIG_APPLICATION_INIT_PRIORITY);

/* Empty main */
int main(void) { return 0; }
```
