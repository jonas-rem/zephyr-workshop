## app/src/components/button/tests/testcase.yaml
```yaml
tests:
  component.button:
    platform_allow:
      - native_sim
      - qemu_cortex_m3
    tags:
      - button
      - zbus
      - component
    integration_platforms:
      - native_sim
      - qemu_cortex_m3
    timeout: 5
```

## app/src/components/led/tests/testcase.yaml
```yaml
tests:
  component.led:
    platform_allow:
      - native_sim
      - qemu_cortex_m3
    tags:
      - led
      - zbus
      - component
    integration_platforms:
      - native_sim
      - qemu_cortex_m3
    timeout: 10
```

## app/src/components/sensor_log/tests/testcase.yaml
```yaml
tests:
  component.sensor_log:
    platform_allow:
      - native_sim
      - qemu_cortex_m3
    tags:
      - sensor_log
      - zbus
      - component
      - workshop
    integration_platforms:
      - native_sim
      - qemu_cortex_m3
    timeout: 5
```

## app/src/components/sys_ctrl/tests/testcase.yaml
```yaml
tests:
  component.sys_ctrl:
    platform_allow:
      - native_sim
      - qemu_cortex_m3
    tags:
      - sys_ctrl
      - zbus
      - component
    integration_platforms:
      - native_sim
      - qemu_cortex_m3
    timeout: 5
```

## app/src/components/temp_alert/tests/testcase.yaml
```yaml
tests:
  component.temp_alert:
    platform_allow:
      - native_sim
      - qemu_cortex_m3
    tags:
      - temp_alert
      - zbus
      - component
      - workshop
    integration_platforms:
      - native_sim
      - qemu_cortex_m3
    timeout: 5
```

## app/src/components/tempsense/tests/testcase.yaml
```yaml
tests:
  component.tempsense:
    platform_allow:
      - native_sim
      - qemu_cortex_m3
    tags:
      - tempsense
      - zbus
      - sensor
      - component
      - workshop
    integration_platforms:
      - native_sim
      - qemu_cortex_m3
    timeout: 5
```

## app/src/modules/led/Kconfig.led
```kconfig
config APP_TEST_LED
	bool "LED module"
	default y
	depends on GPIO && ZBUS && ZBUS_MSG_SUBSCRIBER

if APP_TEST_LED

module = APP_TEST_LED
module-str = LED
source "subsys/logging/Kconfig.template.log_config"

config APP_TEST_LED_THREAD_PRIORITY
	int "LED thread priority"
	default 5

endif
```

## app/src/modules/sensor/Kconfig.sensor
```kconfig
config APP_TEST_SENSOR
	bool "Temperature and humidity sensor module"
	default y
	depends on SENSOR && ZBUS && ZBUS_MSG_SUBSCRIBER

if APP_TEST_SENSOR

module = APP_TEST_SENSOR
module-str = SENSOR
source "subsys/logging/Kconfig.template.log_config"

config APP_TEST_SENSOR_THREAD_PRIORITY
	int "Sensor thread priority"
	default 5

config APP_TEST_SENSOR_SHELL
	bool "Sensor shell commands"
	default y
	depends on SHELL

endif
```

## samples/01_hello_world/sample.yaml
```yaml
sample:
  description: Hello World sample, the simplest Zephyr
    application
  name: hello world
common:
  tags: introduction
  integration_platforms:
    - native_sim
    - qemu_cortex_m3
    - reel_board
  harness: console
  harness_config:
    type: one_line
    regex:
      - "Hello World! (.*)"
tests:
  sample.basic.helloworld:
    tags: introduction
```

## samples/05_sensor/sample.yaml
```yaml
sample:
  name: sensor test
common:
  integration_platforms:
    - native_sim
    - qemu_cortex_m3
    - reel_board
tests:
  sample.basic.sensor:
    build_only: true
```

## samples/06_gpio/sample.yaml
```yaml
sample:
  name: gpio build test
common:
  integration_platforms:
    - native_sim
    - reel_board
tests:
  sample.basic.gpio:
    build_only: true
```

## samples/iot/thread_telemetry/src/display/Kconfig.display
```kconfig
# Copyright (c) 2026 TiaC Systems
# SPDX-License-Identifier: Apache-2.0

menuconfig TELEMETRY_DISPLAY
	bool "LED strip display"
	depends on LED_STRIP
	default y
	help
	  Show the current temperature as a colour bar on the on-board WS2812
	  strip, or the humidity on a blue-to-purple one. SW0 switches between
	  the two, and so does "telemetry display".

	  This is the second stage of the workshop. The gradients themselves are
	  two arrays at the top of display.c -- changing them is part of the
	  exercise; the options below set the ranges they are stretched over.

if TELEMETRY_DISPLAY

config TELEMETRY_DISPLAY_INTERVAL_MS
	int "LED strip refresh interval in milliseconds"
	default 500
	range 50 10000
	help
	  The strip is refreshed far more often than readings are published, so
	  that a hand on the sensor produces immediate feedback.

config TELEMETRY_DISPLAY_TEMP_MIN_C
	int "Temperature shown at the bottom of the strip, in degrees Celsius"
	default 20

config TELEMETRY_DISPLAY_TEMP_MAX_C
	int "Temperature shown at the top of the strip, in degrees Celsius"
	default 40
	help
	  The default range is deliberately narrow: a hand on the board is the
	  only heat source available, and it moves the reading by a few degrees.

config TELEMETRY_DISPLAY_HUM_MIN_PCT
	int "Relative humidity shown at minimum intensity, in percent"
	default 20

config TELEMETRY_DISPLAY_HUM_MAX_PCT
	int "Relative humidity shown at full intensity, in percent"
	default 80
	help
	  Breathing on the sensor is enough to cross this range.

config TELEMETRY_DISPLAY_BRIGHTNESS
	int "Overall LED brightness, in permille of full output"
	default 500
	range 1 1000
	help
	  Scales every pixel before it reaches the strip. The WS2812s are
	  uncomfortably bright at full output when the board sits on a desk in
	  front of someone, so the default is half.

	  This is a linear duty cycle, while perceived brightness is not, so
	  500 still looks roughly three quarters as bright as full. Go lower if
	  it is still too much.

config TELEMETRY_DISPLAY_INIT_PRIORITY
	int "Init priority"
	default 90
	help
	  SYS_INIT priority within the APPLICATION level. Starts the refresh
	  work, so it comes up after the sensor it reads.

module = TELEMETRY_DISPLAY
module-str = display
source "subsys/logging/Kconfig.template.log_config"

endif # TELEMETRY_DISPLAY
```

## samples/iot/thread_telemetry/src/env_sensor/Kconfig.env_sensor
```kconfig
# Copyright (c) 2026 TiaC Systems
# SPDX-License-Identifier: Apache-2.0

config TELEMETRY_ENV_SENSOR_INIT_PRIORITY
	int "Environment sensor init priority"
	default 80
	help
	  SYS_INIT priority within the APPLICATION level. Lower numbers run
	  earlier, so the modules that read the sensor come up after it.

module = TELEMETRY_ENV_SENSOR
module-str = env_sensor
source "subsys/logging/Kconfig.template.log_config"
```

## samples/iot/thread_telemetry/src/mesh/Kconfig.mesh
```kconfig
# Copyright (c) 2026 TiaC Systems
# SPDX-License-Identifier: Apache-2.0

menuconfig TELEMETRY_MESH
	bool "Thread mesh"
	depends on NET_L2_OPENTHREAD
	default y
	help
	  Track the node's Thread role and report it. This is what the
	  publishing module and the status LED are built on, and it is the
	  third stage of the workshop -- the two earlier stages build without
	  any radio at all.

	  Joining the mesh itself is OpenThread's business, configured with the
	  CONFIG_OPENTHREAD_* options and the credentials in prj.conf.

if TELEMETRY_MESH

config TELEMETRY_MESH_INIT_PRIORITY
	int "Init priority"
	default 85
	help
	  SYS_INIT priority within the APPLICATION level. Only registers an
	  OpenThread state changed callback, so it has no ordering constraint
	  against the other modules.

module = TELEMETRY_MESH
module-str = mesh
source "subsys/logging/Kconfig.template.log_config"

endif # TELEMETRY_MESH
```

## samples/iot/thread_telemetry/src/node_name/Kconfig.node_name
```kconfig
# Copyright (c) 2026 TiaC Systems
# SPDX-License-Identifier: Apache-2.0

menuconfig TELEMETRY_NODE_NAME
	bool "Participant-chosen node name"
	depends on SETTINGS
	default y
	select HWINFO
	help
	  Give the board a name that survives a reboot and a re-flash. Every
	  publication carries it, so participants can find their own data on
	  the shared dashboard.

	  Without a stored name, one is derived from the device ID, so two
	  unconfigured boards never collide.

if TELEMETRY_NODE_NAME

config TELEMETRY_NAME_MAX_LEN
	int "Maximum length of the node name"
	default 24
	range 4 63
	help
	  Upper bound for the participant-chosen node name, excluding the
	  terminating NUL. Longer names are rejected by "telemetry name".

	  The name is sent in every publication, so this directly sets how much
	  airtime each node spends per interval. The telemetry buffer is sized
	  from this value, so raising it costs RAM but cannot overflow.

config TELEMETRY_NODE_NAME_INIT_PRIORITY
	int "Init priority"
	default 80
	help
	  SYS_INIT priority within the APPLICATION level. The name has to be
	  loaded from storage before the first publication is formatted.

module = TELEMETRY_NODE_NAME
module-str = node_name
source "subsys/logging/Kconfig.template.log_config"

endif # TELEMETRY_NODE_NAME
```

## samples/iot/thread_telemetry/src/sensor_console/Kconfig.sensor_console
```kconfig
# Copyright (c) 2026 TiaC Systems
# SPDX-License-Identifier: Apache-2.0

menuconfig TELEMETRY_SENSOR_CONSOLE
	bool "Print the readings on the console"
	default y if !TELEMETRY_PUBLISH
	help
	  Read the sensor periodically and print the reading. This is the whole
	  node in the first stage of the workshop, before there is anywhere to
	  send the data.

	  The publishing module logs its own payload, so this defaults to off
	  once publishing is enabled. Turn it back on to see the readings
	  between two publications.

if TELEMETRY_SENSOR_CONSOLE

config TELEMETRY_SENSOR_CONSOLE_INTERVAL_S
	int "Seconds between two logged readings"
	default 5
	range 1 3600
	help
	  Faster than the publish interval, so that a hand on the sensor shows
	  up in the console within a few seconds.

config TELEMETRY_SENSOR_CONSOLE_INIT_PRIORITY
	int "Init priority"
	default 90
	help
	  SYS_INIT priority within the APPLICATION level. Starts the periodic
	  read, so it comes up after the sensor.

module = TELEMETRY_SENSOR_CONSOLE
module-str = sensor_console
source "subsys/logging/Kconfig.template.log_config"

endif # TELEMETRY_SENSOR_CONSOLE
```

## samples/iot/thread_telemetry/src/status_led/Kconfig.status_led
```kconfig
# Copyright (c) 2026 TiaC Systems
# SPDX-License-Identifier: Apache-2.0

menuconfig TELEMETRY_STATUS_LED
	bool "Mesh status LED"
	depends on TELEMETRY_MESH && GPIO
	default y
	help
	  Light LD1 while the node is attached to the mesh.

if TELEMETRY_STATUS_LED

config TELEMETRY_STATUS_LED_INIT_PRIORITY
	int "Init priority"
	default 90
	help
	  SYS_INIT priority within the APPLICATION level.

module = TELEMETRY_STATUS_LED
module-str = status_led
source "subsys/logging/Kconfig.template.log_config"

endif # TELEMETRY_STATUS_LED
```

## samples/iot/thread_telemetry/src/telemetry/Kconfig.telemetry
```kconfig
# Copyright (c) 2026 TiaC Systems
# SPDX-License-Identifier: Apache-2.0

menuconfig TELEMETRY_PUBLISH
	bool "CoAP publishing"
	depends on TELEMETRY_MESH && OPENTHREAD_COAP && TELEMETRY_NODE_NAME
	default y
	help
	  POST every reading to the collector as JSON over CoAP. This is the
	  last stage of the workshop, and the point of the whole node.

	  Needs the mesh to send over and the node name to sign the reading
	  with, so both have to be enabled first.

if TELEMETRY_PUBLISH

config TELEMETRY_URI_PATH
	string "CoAP URI path the node posts to"
	default "telemetry"
	help
	  URI path of the CoAP resource on the collector. The bridge next to
	  the border router listens here and republishes every POST to MQTT.

config TELEMETRY_COLLECTOR_ADDRESS
	string "IPv6 address of the collector"
	default "ff03::1"
	help
	  Destination of the CoAP POST. The default is the realm-local
	  all-nodes multicast address, which reaches the border router without
	  any per-node configuration -- that is what makes this sample work
	  out of the box in a workshop room.

	  Set a unicast address here (or use "telemetry collector <addr>" at
	  runtime) once the collector address is known and the extra multicast
	  traffic is no longer wanted.

config TELEMETRY_INTERVAL_S
	int "Publish interval in seconds"
	default 15
	range 1 3600
	help
	  Time between two telemetry publications.

config TELEMETRY_INIT_PRIORITY
	int "Init priority"
	default 90
	help
	  SYS_INIT priority within the APPLICATION level. Starts CoAP and the
	  periodic publish work, so it comes up after the sensor and the node
	  name it depends on.

module = TELEMETRY
module-str = telemetry
source "subsys/logging/Kconfig.template.log_config"

endif # TELEMETRY_PUBLISH
```

## samples/sim_test_track/src/modules/button/Kconfig.button
```kconfig
config SIM_TEST_TRACK_BUTTON
	bool "Button module"
	default y
	depends on GPIO && ZBUS

if SIM_TEST_TRACK_BUTTON

module = SIM_TEST_TRACK_BUTTON
module-str = BUTTON
source "subsys/logging/Kconfig.template.log_config"

config SIM_TEST_TRACK_BUTTON_INIT_PRIORITY
	int "Button initialization priority"
	default 80

config SIM_TEST_TRACK_BUTTON_SHELL
	bool "Button emulator shell command"
	default y
	depends on SHELL && GPIO_EMUL

endif
```

## samples/sim_test_track/src/modules/led/Kconfig.led
```kconfig
config SIM_TEST_TRACK_LED
	bool "LED module"
	default y
	depends on GPIO && ZBUS && ZBUS_MSG_SUBSCRIBER

if SIM_TEST_TRACK_LED

module = SIM_TEST_TRACK_LED
module-str = LED
source "subsys/logging/Kconfig.template.log_config"

config SIM_TEST_TRACK_LED_THREAD_PRIORITY
	int "LED thread priority"
	default 5

endif
```

## samples/sim_test_track/src/modules/led/tests/Kconfig
```kconfig
menu "Application"
rsource "../Kconfig.led"
endmenu

menu "Zephyr Kernel"
source "Kconfig.zephyr"
endmenu
```

## samples/sim_test_track/src/modules/sensor/Kconfig.sensor
```kconfig
config SIM_TEST_TRACK_SENSOR
	bool "Temperature and humidity sensor module"
	default y
	depends on SENSOR && ZBUS && ZBUS_MSG_SUBSCRIBER

if SIM_TEST_TRACK_SENSOR

module = SIM_TEST_TRACK_SENSOR
module-str = SENSOR
source "subsys/logging/Kconfig.template.log_config"

config SIM_TEST_TRACK_SENSOR_THREAD_PRIORITY
	int "Sensor thread priority"
	default 5

config SIM_TEST_TRACK_SENSOR_SHELL
	bool "Sensor shell commands"
	default y
	depends on SHELL

endif
```
