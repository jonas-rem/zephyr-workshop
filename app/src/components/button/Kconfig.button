## app/src/components/button/Kconfig.button
```kconfig
# Copyright (c) 2026 Jonas Remmert
# SPDX-License-Identifier: Apache-2.0

config BUTTON_COMPONENT
	bool "Button component"
	default y
	help
	  Enable the button component for handling physical button inputs
	  and publishing button events via Zbus.

module = BUTTON_COMPONENT
module-str = BUTTON
source "subsys/logging/Kconfig.template.log_config"

config BUTTON_COMPONENT_INIT_PRIORITY
	int "Button component init priority"
	default 80
	help
	  System initialization priority for the button component.
	  This determines the order in which the button component is initialized.

config BUTTON_COMPONENT_SHELL
	bool "Button component shell commands"
	depends on SHELL
	default n
	help
	  Enable shell commands for the button component.
	  Provides commands to simulate button presses for testing.
```

## app/src/components/button_mock/Kconfig.button_mock
```kconfig
# Copyright (c) 2026 Jonas Remmert
# SPDX-License-Identifier: Apache-2.0

config BUTTON_MOCK_COMPONENT
	bool "Button mock component for native_sim"
	depends on BOARD_NATIVE_SIM
	default y
	help
	  Enable button mock component that simulates physical button presses
	  using the GPIO emulator for native_sim builds.

module = BUTTON_MOCK_COMPONENT
module-str = button_mock
source "subsys/logging/Kconfig.template.log_config"

config BUTTON_MOCK_COMPONENT_INIT_PRIORITY
	int "Button mock component init priority"
	default 80
	help
	  System initialization priority for the button mock component.
	  This determines the order in which the button mock component is initialized.
```

## app/src/components/led/Kconfig.led
```kconfig
# Copyright (c) 2026 Jonas Remmert
# SPDX-License-Identifier: Apache-2.0

config LED_COMPONENT
	bool "LED component"
	default y
	help
	  Enable the LED component for visual feedback via board LEDs.

if LED_COMPONENT

module = LED_COMPONENT
module-str = LED
source "subsys/logging/Kconfig.template.log_config"

config LED_COMPONENT_THREAD_STACK_SIZE
	int "Thread stack size"
	default 1024

config LED_COMPONENT_THREAD_STACK_PRIO
	int "Thread stack priority"
	default -2

config LED_COMPONENT_SHELL
	bool "LED component shell commands"
	depends on SHELL
	default n
	help
	  Enable shell commands for controlling the LED component.
	  Provides commands to set LED states manually for testing.

config LED_COMPONENT_INIT_PRIORITY
	int "LED component init priority"
	default 90
	help
	  System initialization priority for the LED component.
	  This determines the order in which the LED component is initialized.

endif # LED_COMPONENT
```

## app/src/components/sensor_log/Kconfig.sensor_log
```kconfig
# Copyright (c) 2026 Jonas Remmert
# SPDX-License-Identifier: Apache-2.0

config SENSOR_LOG_COMPONENT
	bool "Sensor log module"
	default y
	help
	  Enable the sensor log module that records sensor readings,
	  alerts, and state changes with timestamps. Provides shell
	  commands for log inspection.

if SENSOR_LOG_COMPONENT

module = SENSOR_LOG
module-str = SENSOR_LOG
source "subsys/logging/Kconfig.template.log_config"

config SENSOR_LOG_BUFFER_SIZE
	int "Sensor log buffer size (number of entries)"
	default 100
	help
	  Number of log entries to store in the ring buffer.
	  When the buffer is full, oldest entries are overwritten.

config SENSOR_LOG_INIT_PRIORITY
	int "Sensor log module init priority"
	default 80
	help
	  System initialization priority for the sensor log module.
	  Set to 80 to initialize before components that publish on boot.

config SENSOR_LOG_SHELL
	bool "Sensor commands for sensor_log"
	default n
	help
	  Enable shell commands for the sensor log module.
	  Provides "sensor_log last" and "sensor_log history" commands.

endif # SENSOR_LOG_COMPONENT
```

## app/src/components/sys_ctrl/Kconfig.sys_ctrl
```kconfig
# Copyright (c) 2026 Jonas Remmert
# SPDX-License-Identifier: Apache-2.0

config SYS_CTRL_COMPONENT
	bool "System control component"
	default y
	help
	  Enable the system control component that manages system state
	  and coordinates between other components via Zbus.

module = SYS_CTRL_COMPONENT
module-str = sys_ctrl
source "subsys/logging/Kconfig.template.log_config"

config SYS_CTRL_COMPONENT_INIT_PRIORITY
	int "System control component init priority"
	default 85
	help
	  System initialization priority for the system control component.
	  This determines the order in which the system control component is initialized.

config SYS_CTRL_COMPONENT_SHELL
	bool "System control component shell commands"
	depends on SHELL
	default n
	help
	  Enable shell commands for the system control component.
	  Provides commands to check system state and simulate events for testing.
```

## app/src/components/temp_alert/Kconfig.temp_alert
```kconfig
# Copyright (c) 2026 Jonas Remmert
# SPDX-License-Identifier: Apache-2.0

config TEMP_ALERT_COMPONENT
	bool "Temperature alert module"
	default y
	help
	  Enable the temperature alert module that monitors sensor readings
	  and publishes alerts when the temperature exceeds a threshold.

if TEMP_ALERT_COMPONENT

module = TEMP_ALERT
module-str = TEMP_ALERT
source "subsys/logging/Kconfig.template.log_config"

config TEMP_ALERT_THRESHOLD
	int "Temperature alert threshold (in 0.01°C)"
	default 500
	help
	  Temperature threshold in 0.01°C units. Default is 500 (5°C).
	  When temperature exceeds this value for 2 consecutive readings,
	  a SYS_TEMP_ALERT event is published.

config TEMP_ALERT_INIT_PRIORITY
	int "Temperature alert module init priority"
	default 90
	help
	  System initialization priority for the temperature alert module.

config TEMP_ALERT_SHELL
	bool "Shell commands for temp_alert"
	default n
	help
	  Enable shell commands for the temperature alert module.

endif # TEMP_ALERT_COMPONENT
```

## app/src/components/tempsense/Kconfig.tempsense
```kconfig
# Copyright (c) 2026 Jonas Remmert
# SPDX-License-Identifier: Apache-2.0

config TEMPSENSE_COMPONENT
	bool "Temperature sensor module"
	default y
	depends on SENSOR
	help
	  Enable the temperature sensor module that reads temperature
	  from a TI HDC sensor and publishes readings to event_ch.

if TEMPSENSE_COMPONENT

module = TEMPSENSE
module-str = TEMPSENSE
source "subsys/logging/Kconfig.template.log_config"

config TEMPSENSE_SAMPLE_INTERVAL_MS
	int "Sample interval in milliseconds"
	default 1000
	help
	  Time between temperature readings in milliseconds.
	  Default is 1000 ms (1 reading per second).

config TEMPSENSE_INIT_PRIORITY
	int "Temperature sensor module init priority"
	default 80
	help
	  System initialization priority for the temperature sensor module.
	  Must be lower than SYS_CTRL_COMPONENT_INIT_PRIORITY (default 85)
	  to ensure the sensor is ready before system state changes.

config TEMPSENSE_SHELL
	bool "Temperature sensor shell commands"
	depends on SHELL
	default n
	help
	  Enable shell commands for manual temperature sensor interaction.
	  Provides commands to read temperature and check status.

endif # TEMPSENSE_COMPONENT
```

## app/src/components/tracing_usb/Kconfig.tracing_usb
```kconfig
menuconfig TRACING_USB_COMPONENT
	bool "USB Tracing Support"
	depends on TRACING
	select USB_DEVICE_STACK_NEXT
	help
	  Enable USB device initialization for CTF tracing backend.
	  This component initializes the USB device stack when using
	  CONFIG_TRACING_BACKEND_USB for hardware-based tracing.
	  Enable this together with CONFIG_TRACING_BACKEND_USB=y

if TRACING_USB_COMPONENT

config TRACING_USB_VID
	hex "USB Vendor ID"
	default 0x2FE3
	help
	  USB Vendor ID for the tracing device.
	  Default is Nordic Semiconductor (0x2FE3).

config TRACING_USB_PID
	hex "USB Product ID"
	default 0x0001
	help
	  USB Product ID for the tracing device.

config TRACING_USB_MANUFACTURER
	string "USB Manufacturer String"
	default "Zephyr Project"
	help
	  Manufacturer string for the USB device descriptor.

config TRACING_USB_PRODUCT
	string "USB Product String"
	default "Zephyr Tracing Device"
	help
	  Product string for the USB device descriptor.

config TRACING_USB_MAX_POWER
	int "USB Max Power (mA/2)"
	default 125
	help
	  Maximum power consumption in 2mA units.
	  Default 125 = 250mA.

config TRACING_USB_SELF_POWERED
	bool "Self Powered"
	default y
	help
	  Device is self-powered.

config TRACING_USB_REMOTE_WAKEUP
	bool "Remote Wakeup"
	default n
	help
	  Device supports remote wakeup.

config TRACING_USB_20_EXTENSION_DESC
	bool "USB 2.0 Extension Descriptor"
	default n
	help
	  Add USB 2.0 Extension Descriptor.

module = TRACING_USB_COMPONENT
module-str = tracing_usb
source "subsys/logging/Kconfig.template.log_config"

config TRACING_USB_COMPONENT_INIT_PRIORITY
	int "USB tracing component init priority"
	default 95
	help
	  System initialization priority for the USB tracing component.
	  This determines the order in which the USB tracing component is initialized.

endif # TRACING_USB_COMPONENT
```

## app/src/modules/button/Kconfig.button
```kconfig
module = BUTTON_MODULE
module-str = BUTTON
source "subsys/logging/Kconfig.template.log_config"
```

## app/src/modules/button_mock/Kconfig.button_mock
```kconfig
# Copyright (c) 2026 Jonas Remmert
# SPDX-License-Identifier: Apache-2.0

config BUTTON_MOCK
	bool "Button mock module for native_sim"
	depends on BOARD_NATIVE_SIM
	default y
	help
	  Enable button mock module that simulates physical button presses
	  using the GPIO emulator for native_sim builds.

module = BUTTON_MOCK
module-str = button_mock
source "subsys/logging/Kconfig.template.log_config"

config BUTTON_MOCK_INIT_PRIORITY
	int "Button mock module init priority"
	default 80
	help
	  System initialization priority for the button mock module.
	  This determines the order in which the button mock module is initialized.
```

## boards/native_sim.conf
```kconfig
CONFIG_EMUL=y
CONFIG_ENTROPY_GENERATOR=y

# CONFIG_SHELL implies LOG_RUNTIME_FILTERING, breaking per-module log levels
CONFIG_LOG_RUNTIME_FILTERING=n
CONFIG_SHELL_LOG_BACKEND=n
```

## emulators/sensor/Kconfig
```kconfig
# SPDX-License-Identifier: Apache-2.0

if SENSOR
rsource "ti_hdc_emul/Kconfig"
endif # SENSOR
```

## emulators/sensor/ti_hdc_emul/Kconfig
```kconfig
# SPDX-License-Identifier: Apache-2.0

config EMUL_TI_HDC
	bool "TI HDC temperature/humidity sensor emulator"
	default y
	depends on EMUL
	depends on TI_HDC
	help
	  Emulator for the TI HDC family (HDC1010/1080) I2C temperature and humidity sensor.
	  Provides canned readings for use with native_sim.
```

## samples/03_workqueues/sample.yaml
```yaml
sample:
  name: workqueue test
common:
  integration_platforms:
    - native_sim
tests:
  sample.basic.workqueue:
    build_only: true
```

## samples/04_shell/sample.yaml
```yaml
sample:
  name: console build test
common:
  integration_platforms:
    - native_sim
    - reel_board
tests:
  sample.basic.console:
    build_only: true
```

## samples/06_ble/sample.yaml
```yaml
sample:
  name: ble build test
common:
  integration_platforms:
    - reel_board
tests:
  sample.basic.ble:
    build_only: true
```

## samples/07_ble/sample.yaml
```yaml
sample:
  name: ble build test
common:
  integration_platforms:
    - native_sim
    - reel_board
tests:
  sample.basic.ble:
    build_only: true
```

## samples/08_display_cfb/sample.yaml
```yaml
common:
  harness: display
  tags: display
  integration_platforms:
    - reel_board@2
sample:
  description: Character framebuffer test
  name: cfb sample
tests:
  sample.display.cfb:
    build_only: true
```

## samples/09_sys_init/sample.yaml
```yaml
sample:
  description: Demonstrates SYS_INIT macro for automatic
    module initialization
  name: sys_init
common:
  tags: sys_init initialization
  integration_platforms:
    - native_sim
    - reel_board
  harness: console
  harness_config:
    type: multi_line
    ordered: true
    regex:
      - "Module 1 initialized.*APPLICATION.*priority: 0"
      - "Module 2 initialized.*APPLICATION.*priority: 999"
      - "Hello World!.*"
tests:
  sample.basic.sys_init:
    tags: sys_init initialization
```
